## exynos/device/erd/erd8825/Kconfig.ext
```kconfig
source "$(KCONFIG_EXT_SOC_PREFIX)Kconfig.ext"

source "$(KCONFIG_EXT_PREFIX)Kconfig.ext_modules"

source "$(KCONFIG_EXT_PREFIX)drivers/input/touchscreen/sec_ts/Kconfig"
source "$(KCONFIG_EXT_PREFIX)sound/soc/codecs/Kconfig"
source "$(KCONFIG_EXT_PREFIX)sound/soc/codecs/aw882xx/Kconfig"
source "$(KCONFIG_EXT_PREFIX)sound/soc/codecs/tfa9878/Kconfig"
source "$(KCONFIG_EXT_PREFIX)sound/soc/codecs/dbmdx/Kconfig"
source "$(KCONFIG_EXT_PREFIX)sound/soc/samsung/exynos/Kconfig"
source "$(KCONFIG_EXT_PREFIX)sound/soc/samsung/exynos/abox/Kconfig"
source "$(KCONFIG_EXT_PREFIX)drivers/tee/tzdev/Kconfig"
source "$(KCONFIG_EXT_PREFIX)drivers/tee/tui/Kconfig"

source "$(KCONFIG_EXT_PREFIX)drivers/usb/dwc3/Kconfig"

source "$(KCONFIG_EXT_PREFIX)drivers/usb/gadget/function/Kconfig"

source "$(KCONFIG_EXT_PREFIX)drivers/knox/Kconfig"
source "$(KCONFIG_EXT_PREFIX)drivers/samsung/pm/Kconfig"
source "$(KCONFIG_EXT_PREFIX)drivers/ufs/Kconfig"
source "$(KCONFIG_EXT_PREFIX)drivers/mmc/Kconfig"
source "$(KCONFIG_EXT_PREFIX)drivers/camera/Kconfig"
source "$(KCONFIG_EXT_PREFIX)drivers/leds/Kconfig"
source "$(KCONFIG_EXT_PREFIX)block/Kconfig"
source "$(KCONFIG_EXT_PREFIX)drivers/sec_panel_notifier_v2/Kconfig" # ADDED BY LEGO AUTOMATICALLY: DO NOT SUBMIT
source "$(KCONFIG_EXT_PREFIX)drivers/usb/typec/slsi/s2mf301/Kconfig" # ADDED BY LEGO AUTOMATICALLY: DO NOT SUBMIT
source "$(KCONFIG_EXT_PREFIX)drivers/gpu/drm/samsung/panel/db7f2010b/Kconfig" # ADDED BY LEGO AUTOMATICALLY: DO NOT SUBMIT
source "$(KCONFIG_EXT_PREFIX)drivers/gpu/drm/samsung/panel/db7f2010b/kunit_test/Kconfig" # ADDED BY LEGO AUTOMATICALLY: DO NOT SUBMIT
source "$(KCONFIG_EXT_PREFIX)drivers/gpu/drm/samsung/panel/oled_common/Kconfig" # ADDED BY LEGO AUTOMATICALLY: DO NOT SUBMIT
source "$(KCONFIG_EXT_PREFIX)drivers/usb/typec/slsi/common/Kconfig" # ADDED BY LEGO AUTOMATICALLY: DO NOT SUBMIT
source "$(KCONFIG_EXT_PREFIX)security/samsung/defex_lsm/Kconfig" # ADDED BY LEGO AUTOMATICALLY: DO NOT SUBMIT
source "$(KCONFIG_EXT_PREFIX)security/samsung/proca/Kconfig" # ADDED BY LEGO AUTOMATICALLY: DO NOT SUBMIT
source "$(KCONFIG_EXT_PREFIX)security/samsung/proca/gaf/Kconfig" # ADDED BY LEGO AUTOMATICALLY: DO NOT SUBMIT
source "$(KCONFIG_EXT_PREFIX)drivers/input/sec_input/Kconfig" # ADDED BY LEGO AUTOMATICALLY: DO NOT SUBMIT
source "$(KCONFIG_EXT_PREFIX)drivers/vibrator/common/vib_info/Kconfig" # ADDED BY LEGO AUTOMATICALLY: DO NOT SUBMIT
source "$(KCONFIG_EXT_PREFIX)drivers/dpu/panel/Kconfig" # ADDED BY LEGO AUTOMATICALLY: DO NOT SUBMIT
source "$(KCONFIG_EXT_PREFIX)security/samsung/mz/Kconfig" # ADDED BY LEGO AUTOMATICALLY: DO NOT SUBMIT
source "$(KCONFIG_EXT_PREFIX)drivers/misc/drb/Kconfig" # ADDED BY LEGO AUTOMATICALLY: DO NOT SUBMIT
source "$(KCONFIG_EXT_PREFIX)drivers/vibrator/common/Kconfig" # ADDED BY LEGO AUTOMATICALLY: DO NOT SUBMIT
source "$(KCONFIG_EXT_PREFIX)drivers/net/dropdump/Kconfig" # ADDED BY LEGO AUTOMATICALLY: DO NOT SUBMIT
source "$(KCONFIG_EXT_PREFIX)drivers/muic/common/Kconfig" # ADDED BY LEGO AUTOMATICALLY: DO NOT SUBMIT
source "$(KCONFIG_EXT_PREFIX)drivers/input/input_boost/Kconfig" # ADDED BY LEGO AUTOMATICALLY: DO NOT SUBMIT
source "$(KCONFIG_EXT_PREFIX)drivers/sti/common/Kconfig" # ADDED BY LEGO AUTOMATICALLY: DO NOT SUBMIT
source "$(KCONFIG_EXT_PREFIX)drivers/usb/notify/Kconfig" # ADDED BY LEGO AUTOMATICALLY: DO NOT SUBMIT
source "$(KCONFIG_EXT_PREFIX)drivers/battery/core/Kconfig" # ADDED BY LEGO AUTOMATICALLY: DO NOT SUBMIT
source "$(KCONFIG_EXT_PREFIX)drivers/kq/mesh/Kconfig" # ADDED BY LEGO AUTOMATICALLY: DO NOT SUBMIT
source "$(KCONFIG_EXT_PREFIX)drivers/kperfmon/Kconfig" # ADDED BY LEGO AUTOMATICALLY: DO NOT SUBMIT
source "$(KCONFIG_EXT_PREFIX)drivers/gpu/drm/samsung/panel/s6e8fc3/Kconfig" # ADDED BY LEGO AUTOMATICALLY: DO NOT SUBMIT
source "$(KCONFIG_EXT_PREFIX)drivers/gpu/drm/samsung/panel/s6e8fc3/kunit_test/Kconfig" # ADDED BY LEGO AUTOMATICALLY: DO NOT SUBMIT
source "$(KCONFIG_EXT_PREFIX)drivers/staging/android/switch/Kconfig" # ADDED BY LEGO AUTOMATICALLY: DO NOT SUBMIT
source "$(KCONFIG_EXT_PREFIX)security/samsung/five/Kconfig" # ADDED BY LEGO AUTOMATICALLY: DO NOT SUBMIT
source "$(KCONFIG_EXT_PREFIX)drivers/usb/common/vbus_notifier/Kconfig" # ADDED BY LEGO AUTOMATICALLY: DO NOT SUBMIT
source "$(KCONFIG_EXT_PREFIX)security/samsung/mz_tee_driver/Kconfig" # ADDED BY LEGO AUTOMATICALLY: DO NOT SUBMIT
source "$(KCONFIG_EXT_PREFIX)drivers/usb/typec/manager/Kconfig" # ADDED BY LEGO AUTOMATICALLY: DO NOT SUBMIT
source "$(KCONFIG_EXT_PREFIX)drivers/fingerprint/Kconfig" # ADDED BY LEGO AUTOMATICALLY: DO NOT SUBMIT
source "$(KCONFIG_EXT_PREFIX)drivers/muic/slsi/platform/Kconfig" # ADDED BY LEGO AUTOMATICALLY: DO NOT SUBMIT
source "$(KCONFIG_EXT_PREFIX)drivers/gpu/drm/Kconfig" # ADDED BY LEGO AUTOMATICALLY: DO NOT SUBMIT
source "$(KCONFIG_EXT_PREFIX)drivers/gpu/drm/samsung/panel/Kconfig" # ADDED BY LEGO AUTOMATICALLY: DO NOT SUBMIT
source "$(KCONFIG_EXT_PREFIX)drivers/usb/typec/common/Kconfig" # ADDED BY LEGO AUTOMATICALLY: DO NOT SUBMIT
source "$(KCONFIG_EXT_PREFIX)drivers/sti/abc/Kconfig" # ADDED BY LEGO AUTOMATICALLY: DO NOT SUBMIT
source "$(KCONFIG_EXT_PREFIX)drivers/mfd/slsi/s2mf301/Kconfig" # ADDED BY LEGO AUTOMATICALLY: DO NOT SUBMIT
source "$(KCONFIG_EXT_PREFIX)drivers/battery/charger/nu2111a_charger/Kconfig" # ADDED BY LEGO AUTOMATICALLY: DO NOT SUBMIT
source "$(KCONFIG_EXT_PREFIX)drivers/nfc/Kconfig" # ADDED BY LEGO AUTOMATICALLY: DO NOT SUBMIT
source "$(KCONFIG_EXT_PREFIX)drivers/muic/slsi/s2mf301/Kconfig" # ADDED BY LEGO AUTOMATICALLY: DO NOT SUBMIT
source "$(KCONFIG_EXT_PREFIX)drivers/battery/fuelgauge/s2mf301_fuelgauge/Kconfig" # ADDED BY LEGO AUTOMATICALLY: DO NOT SUBMIT
source "$(KCONFIG_EXT_PREFIX)drivers/sensorhub/Kconfig" # ADDED BY LEGO AUTOMATICALLY: DO NOT SUBMIT
source "$(KCONFIG_EXT_PREFIX)drivers/sensorhub/debug/Kconfig" # ADDED BY LEGO AUTOMATICALLY: DO NOT SUBMIT
source "$(KCONFIG_EXT_PREFIX)drivers/sensorhub/sensor/Kconfig" # ADDED BY LEGO AUTOMATICALLY: DO NOT SUBMIT
source "$(KCONFIG_EXT_PREFIX)drivers/sensorhub/sensorhub/Kconfig" # ADDED BY LEGO AUTOMATICALLY: DO NOT SUBMIT
source "$(KCONFIG_EXT_PREFIX)drivers/nfc/snvm/Kconfig" # ADDED BY LEGO AUTOMATICALLY: DO NOT SUBMIT
source "$(KCONFIG_EXT_PREFIX)drivers/vibrator/dc/Kconfig" # ADDED BY LEGO AUTOMATICALLY: DO NOT SUBMIT
source "$(KCONFIG_EXT_PREFIX)drivers/input/touchscreen/focaltech/ft3519/Kconfig" # ADDED BY LEGO AUTOMATICALLY: DO NOT SUBMIT
source "$(KCONFIG_EXT_PREFIX)drivers/sensors_lego/Kconfig" # ADDED BY LEGO AUTOMATICALLY: DO NOT SUBMIT
source "$(KCONFIG_EXT_PREFIX)drivers/sensorhub/vendor/Kconfig" # ADDED BY LEGO AUTOMATICALLY: DO NOT SUBMIT
source "$(KCONFIG_EXT_PREFIX)drivers/battery/charger/s2mf301_charger/Kconfig" # ADDED BY LEGO AUTOMATICALLY: DO NOT SUBMIT
source "$(KCONFIG_EXT_PREFIX)drivers/battery/common/Kconfig" # ADDED BY LEGO AUTOMATICALLY: DO NOT SUBMIT
```

## exynos/device/erd/erd8825/Kconfig.ext_modules
```kconfig
source "$(KCONFIG_EXT_MODULES_PREFIX)bsp/class/Kconfig"
source "$(KCONFIG_EXT_MODULES_PREFIX)bsp/reboot/6.6/Kconfig"
source "$(KCONFIG_EXT_MODULES_PREFIX)bsp/factory/src/Kconfig"
source "$(KCONFIG_EXT_MODULES_PREFIX)bsp/debug/6.6_fvc/src/Kconfig"
source "$(KCONFIG_EXT_MODULES_PREFIX)camera/camera/Kconfig"
```

## exynos/device/erd/erd8825/drivers/knox/Kconfig
```kconfig
source "$(KCONFIG_EXT_PREFIX)drivers/knox/ngksm/Kconfig"
source "$(KCONFIG_EXT_PREFIX)drivers/knox/hdm/Kconfig"
```

## exynos/device/erd/erd8825/drivers/leds/Kconfig
```kconfig
# SPDX-License-Identifier: GPL-2.0-only

config LEDS_S2MF301_FLASH
	tristate "FLASH LED support for the S2MF301"
    depends on I2C
	help
	  If you say yes here you will get support for
	  for the LEDS_S2MF301_FLASH led chip.

config LEDS_SM5714
	tristate "LED support for the SM5714"
	depends on MFD_SM5714
	help
	  This option enables support for the LEDs on the SM5714.
```

## exynos/device/erd/erd8825/sound/soc/codecs/Kconfig
```kconfig
# SPDX-License-Identifier: GPL-2.0-only

config SND_SOC_RL6231_MX
	tristate
	default m if SND_SOC_RT5665_MX=m

config SND_SOC_RT5665_MX
	tristate
	depends on I2C

config SND_SOC_RT5691_MX
	tristate
	depends on I2C

config SND_SOC_FS1816
	tristate "FourSemi fs1816 i2c driver"
	depends on I2C

config SND_SOC_TFA9878
	tristate "Goodix TFA9878 amplifier"
	depends on I2C
```

## exynos/device/erd/erd8825/sound/soc/samsung/exynos/Kconfig
```kconfig
# SPDX-License-Identifier: GPL-2.0-only

config SND_SOC_SAMSUNG_EXYNOS_AW882XX
	tristate "AW882XX amp support on exynos"
	select SND_SMARTPA_AW882XX
	select SEC_SND_SYNCHRONIZED_IPC_AW

config SND_SOC_SAMSUNG_EXYNOS_TFA9878_MX
	tristate "TFA9878 amp support on exynos"
	select SND_SOC_TFA9878
	select FW_LOADER_USER_HELPER
	select FW_LOADER_USER_HELPER_FALLBACK
	select SEC_SND_SYNCHRONIZED_IPC_GDX

config SND_SOC_SAMSUNG_EXYNOS8825_AUDIO
	tristate "Sound card support on exynos8825 SEP"
	select SND_SOC_SAMSUNG_ABOX
	select SND_SOC_SAMSUNG_MAILBOX
	select SND_SOC_SAMSUNG_VTS
	select SND_SOC_SAMSUNG_SLIF

config SND_SOC_SAMSUNG_EXYNOS8825_RT5665
	tristate "Sound card with RT5665 codec support on exynos8825 SEP"
	select SND_SOC_SAMSUNG_ABOX
	select SND_SOC_SAMSUNG_MAILBOX
	select SND_SOC_SAMSUNG_VTS
	select SND_SOC_SAMSUNG_SLIF
	select SND_SOC_RT5665_MX

config SND_SOC_SAMSUNG_EXYNOS8825_RT5665_DBMDX
	tristate "Sound card with RT5665 codec and DBMDX support on exynos8825 SEP"
	select SND_SOC_SAMSUNG_ABOX
	select SND_SOC_RT5665_MX

config SND_SOC_SAMSUNG_EXYNOS8825_RT5691
	tristate "Sound card with RT5691 codec support on exynos8825 SEP"
	select SND_SOC_SAMSUNG_ABOX
	select SND_SOC_SAMSUNG_MAILBOX
	select SND_SOC_SAMSUNG_VTS
	select SND_SOC_SAMSUNG_SLIF
	select SND_SOC_RT5691_MX

source "$(KCONFIG_EXT_SOC_PREFIX)sound/soc/samsung/exynos/abox/Kconfig"
source "$(KCONFIG_EXT_SOC_PREFIX)sound/soc/samsung/exynos/vts/Kconfig"
source "$(KCONFIG_EXT_SOC_PREFIX)sound/soc/samsung/exynos/slif/Kconfig"
source "$(KCONFIG_EXT_SOC_PREFIX)sound/soc/codecs/Kconfig"
```

## exynos/device/erd/erd8825/sound/soc/samsung/exynos/abox/Kconfig
```kconfig
# SPDX-License-Identifier: GPL-2.0-only

config SEC_SND_SYNCHRONIZED_IPC_AW
	tristate "Samsung SYNC IPC AW"
	help
	  Say Y or M if you want to add support for external devices attached to
	  the Samsung SoC ABOX interface. You will also need to
	  select the audio interfaces to support below.

config SEC_SND_SYNCHRONIZED_IPC_GDX
	tristate "Samsung SYNC IPC GDX"
	help
	  Say Y or M if you want to add support for external devices attached to
	  the Samsung SoC ABOX interface. You will also need to
	  select the audio interfaces to support below.
```

## exynos/device/univ/universal9925/Kconfig.ext
```kconfig
source "$(KCONFIG_EXT_SOC_PREFIX)Kconfig.ext"

source "$(KCONFIG_EXT_PREFIX)Kconfig.ext_modules"

source "$(KCONFIG_EXT_PREFIX)drivers/input/touchscreen/sec_input/Kconfig"

source "$(KCONFIG_EXT_PREFIX)drivers/input/touchscreen/stm/stm_spi/Kconfig"
# IFPMIC max77705
source "$(KCONFIG_EXT_PREFIX)drivers/battery/Kconfig"
source "$(KCONFIG_EXT_PREFIX)drivers/mfd/max77705/Kconfig"
source "$(KCONFIG_EXT_PREFIX)drivers/usb/notify/Kconfig"
source "$(KCONFIG_EXT_PREFIX)drivers/muic-mcd/Kconfig"
source "$(KCONFIG_EXT_PREFIX)drivers/samsung/Kconfig"
source "$(KCONFIG_EXT_PREFIX)drivers/staging/android/switch/Kconfig"
source "$(KCONFIG_EXT_PREFIX)drivers/usb/typec/Kconfig"
```

## exynos/device/univ/universal9925/drivers/battery/Kconfig
```kconfig
#
# battery driver configuration
#

menu "Samsung Battery drivers"

source "$(KCONFIG_EXT_PREFIX)drivers/battery/fuelgauge/Kconfig"
source "$(KCONFIG_EXT_PREFIX)drivers/battery/charger/Kconfig"
source "$(KCONFIG_EXT_PREFIX)drivers/battery/wireless/Kconfig"
source "$(KCONFIG_EXT_PREFIX)drivers/battery/common/Kconfig"

endmenu
```

## exynos/device/univ/universal9925/drivers/battery/charger/Kconfig
```kconfig
menu "Charger drivers"

config CHARGER_DUMMY
	bool "dummy charger driver"
	default n
	depends on BATTERY_SAMSUNG
	help
	  Say Y here to enable
	  support for dummy charger driver.
	  This driver source code implemented
	  skeleton source code for charger functions.

config CHARGER_MAX77705_MODULE
	tristate "MAX77705 battery charger support (modularizes)"
	depends on BATTERY_SAMSUNG
	help
	  Say Y or M here to enable
	  support for the MAX77705 charger.
	  This is Switching Mode Charger.
	  This includes boost mode.
	  To compile the driver as a module, choose M here.

config CHARGER_MAX77705
	bool "MAX77705 battery charger support"
	depends on BATTERY_SAMSUNG
	help
	  Say Y here to enable
	  support for the MAX77705 charger.
	  This includes boost mode.
	  This is Switching Mode Charger.

config MAX77705_CHECK_B2SOVRC
	bool "enable for check B2SOVRC"
	default n
	depends on CHARGER_MAX77705
	help
	  Say Y here to enable
	  support for CHARGER_MAX77705 check B2SCOVRC.
	  MAX77705 onply supports this checking options.
	  this is for MAX77705 monitoring B2SCOVRC.

config CHARGER_PCA9468_MODULE
	tristate "PCA9468 charger driver (modularizes)"
	default n
	depends on DIRECT_CHARGING
	help
	  Say Y or M here,
	  to enable support for the PCA9468 charger.
	  This is 2:1 switched capacitor direct charger.
	  To compile the driver as a module, choose M here.

config SEND_PDMSG_IN_PPS_REQUEST_WORK
	bool "PCA9468 send pdmsg in request work"
	default n
	help
	  Say Y here to enable
	  support for send pdmsg in direct charger.
	  This options for pdic not support periodic send pdmsg.
	  If this is Y in direct charger, direct charger send pdmsg periodic.

config CHARGER_SM5714
	tristate "SM5714 battery charger support"
	default n
	help
	  Say Y here to enable support for the SM5714 charger
	  SM5714 is charger systems for lithium-ion (Li+) batteries
	  in handheld and portable equipment.

endmenu
```
