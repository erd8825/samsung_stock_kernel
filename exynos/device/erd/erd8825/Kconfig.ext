## exynos/device/univ/universal9925/drivers/battery/common/Kconfig
```kconfig
menu "Samsung Battery Common drivers"

config BATTERY_SAMSUNG_MODULE
	tristate "use samsung battery driver (modularizes)"
	help
	  Say Y to include samsung battery driver
	  This battery driver integrated all battery-related functions
	  To see battery-related functions,
	  refer to sec_charging_common.h

config BATTERY_SAMSUNG_SM5714_MODULE
	tristate "use samsung sm5714 battery driver (modularizes)"
	help
	  Say Y to include samsung battery driver
	  This battery driver integrated all battery-related functions
	  To see battery-related functions,
	  refer to sec_charging_common.h

config BATTERY_SAMSUNG
	bool "samsung battery driver"
	help
	  Say Y to include support for samsung battery driver
	  This battery driver integrated all battery-related functions
	  To see battery-related functions,
	  refer to sec_charging_common.h

config CHARGING_VZWCONCEPT
	bool "VZW concept about the charging"
	default n
	depends on BATTERY_SAMSUNG
	help
	  Say Y here to enable
	  support for apply the VZW concepts.
	  VZW models should enable this charging option.
	  it include some charging scenario for VZW models.

config CALC_TIME_TO_FULL
	bool "calculate time to full"
	default n
	depends on BATTERY_SAMSUNG
	help
	  Say Y here to enable
	  support use calc time to full function.
	  it calculates time to full by using battery monitoring.
	  it needs time tables for calculate time.

config STEP_CHARGING
	bool "support for step charging"
	help
	  Say Y here to enable
	  support for step charging.
	  it could be used with direct charging.
	  it needs step charging tables.

config ENABLE_FULL_BY_SOC
	bool "make full by soc 100%"
	help
	default n
	  Say Y here to enable
	  support to make full charged by soc 100%.
	  If this is N in models,
	  battery common drivers make full by other conditions.

config DIRECT_CHARGING_MODULE
	tristate "support for direct charging (modularizes)"
	help
	  Say Y or M here to enable
	  support for direct charging.
	  this driver integrated all direct charging functions.
	  It operates with direct charger IC.
	  To compile the driver as a module, choose M here.

config DIRECT_CHARGING
	bool "support for direct charging"
	help
	  Say Y here to enable
	  support for direct charging.
	  this driver integrated all direct charging functions.
	  It operates with direct charger IC.

config SEC_PD_MODULE
	tristate "support for sec pd (modularizes)"
	help
	 Say Y to include support for sec pd control module.
	 This sec_pd driver integrated all pdo related function.
	 To see pdo related functions,
	 refer to sec_pd.h	 

config SEC_PD_SM5714_MODULE
	tristate "support for sm5714 sec pd (modularizes)"
	help
	 Say Y to include support for sec pd control module.
	 This sec_pd driver integrated all pdo related function.
	 To see pdo related functions,
	 refer to sec_pd.h	 

config SEC_PD
	bool "support for sec pd"
	help
	 Say Y to include support for sec pd control module.
	 This sec_pd driver integrated all pdo related function.
	 To see pdo related functions,
	 refer to sec_pd.h

config UPDATE_BATTERY_DATA
	bool "support for updating battery data"
	default n
	depends on BATTERY_SAMSUNG && OF
	help
	  Say Y here to enable
	  support for update battery data.
	  This integrated load and parsing data functions again.
	  it need to battery data file for update.

config BATTERY_CISD
	bool "support for cisd"
	help
	  Say Y here to enable
	  support for CISD.
	  cisd means cell internal short detection.
	  it include some other detection.

config AFC_CHARGER_MODE
	bool "afc charging support in sec battery driver"
	default n
	help
	  Say Y here to enable
	  support for sec afc charging support
	  it includes some AFC charging options and
	  information about AFC charging.

config SAMSUNG_BATTERY_ENG_TEST
	bool "enable ENG mode for battery test"
	default n
	help
	  Say Y to include support for battery test
	  enable this feature only ENG mode
	  this featuren must disabled user binary
	  stability test etc..

config SAMSUNG_BATTERY_FACTORY
	bool "enable for factory test"
	default n
	help
	  Say Y to include support for factory test
	  enable this feature only factory mode
	  this featuren must disabled user binary
	  stability test etc..

config USE_POGO
	bool "enable pogo charging"
	default n
	help
	  Say Y here to enable
	  support POGO properties.
	  some models support POGO,
	  then it make Y.

config STORE_MODE
	bool "enable store mode"
	default n
	help
	  Say Y here to enable
	  support store mode charging concpet.
	  The LDU or RDU enable this STORE_MODE option,
	  it include some charging scenario for store.

config BATTERY_AGE_FORECAST
	bool "battery age forecast"
	default n
	help
	  Say Y here to enable
	  support AGE FORECAST functions.
	  it include some charging scenario for aged batteries.
	  it need age forecast charging tables.

config ENG_BATTERY_CONCEPT
	bool "enable temp block"
	default n
	help
	  Say Y here to enable
	  support CONFIG_ENG_BATTERY_CONCEPT.
	  It is for only in ENG bianry
	  USER binary should disalbe this.

config LIMIT_CHARGING_DURING_CALL
	bool "limit charging during call"
	default n
	help
	  Say Y here to enable
	  support limit charging during call.
	  some models support this for limiting charging current,
	  then it make Y.

config DUAL_BATTERY
    bool "DUAL BATTERY support"
    depends on I2C
    help
	  Say Y here to enable
	  support for dual battery.
	  This integrated all dual-battery related functions.
	  it needs dual battery tables.

config PREVENT_USB_CONN_OVERHEAT
    bool "enable prevent usb conn overheat"
    default n
    help
	  Say Y here to enable
	  support CONFIG_PREVENT_USB_CONN_OVERHEAT.
	  this is for prevent thermal usb conn.
	  it include some charging scenario for thermal usb conn.

config PD_CHARGER_HV_DISABLE
    bool "enable supporing disable high voltage pd charger"
    depends on BATTERY_SAMSUNG && I2C
    help
	  Say Y here to enable
	  supporting disable high voltage pd charger.
	  some models need this for support options that
	  not support high voltage.

config BATTERY_GKI
    bool "temporary support for GKI build"
    help
	  Say Y here to enable
	  support for module build normally.
	  this is temporary added for prevent build break in module build.
	  it will be deleted soon.

endmenu
```

## exynos/device/univ/universal9925/drivers/battery/fuelgauge/Kconfig
```kconfig
menu "Fuelgauge drivers"

config FUELGAUGE_DUMMY
	bool "dummy fuel gauge driver"
	default n
	depends on BATTERY_SAMSUNG
	help
	  Say Y here, to enable
	  support for dummy fuel gauge driver.
	  This driver source code implemented
	  skeleton source code for fuel gauge functions.

config FUELGAUGE_MAX77705_MODULE
	tristate "MAX77705 fuel gauge driver (modularizes)"
	default n
	depends on BATTERY_SAMSUNG
	help
	  Say Y or M here, to enable
	  support for MAXIM MAX77705 fuel gauge driver.
	  This is fuel-gauge systems for monitoring batteries.
	  This fuel-gauge can be used in coulomb-counting mode.
	  To compile the driver as a module, choose M here.

config FUELGAUGE_MAX77705
	bool "MAX77705 fuel gauge driver"
	default n
	depends on BATTERY_SAMSUNG
	help
	  Say Y here, to enable
	  support for MAXIM MAX77705 fuel gauge driver.
	  This is fuel-gauge systems for monitoring batteries.
	  This fuel-gauge can be used in coulomb-counting mode.

config EN_OOPS
	bool "enable oops filter"
	default n
	help
	  Say Y here to enable
	  support for FUELGAUGE_MAX77705 enable oops filter.
	  MAXIM fuel-gauge only support this option.
	  some battery data values should be defined.

config FUELGAUGE_SM5714
	tristate "Siliconmitus SM5714 Fuel Gauge"
	default n
	depends on I2C
	help
	  SM5714 is fuel-gauge systems for lithium-ion (Li+) batteries
	  in handheld and portable equipment. The SM5714 is configured
	  to operate with a single lithium cell

endmenu
```

## exynos/device/univ/universal9925/drivers/battery/wireless/Kconfig
```kconfig
menu "Wireless Charger drivers"

config WIRELESS_CHARGER_MFC_MODULE
	tristate "MFC IC charger support (modularizes)"
	depends on BATTERY_SAMSUNG && I2C
	help
	  Say Y or M here, to enable
	  support for the MFC IC.
	  MFC include wireless charger driver.
	  It is for IDT.
	  To compile the driver as a module, choose M here.

config WIRELESS_CHARGER_MFC
	bool "MFC IC charger support"
	depends on BATTERY_SAMSUNG && I2C
	help
	  Say Y here, to enable
	  support for the MFC IC
	  MFC include wireless charger driver.
	  It is for IDT.

config WIRELESS_NO_HV
	bool "wireless no hv"
	depends on BATTERY_SAMSUNG && I2C
	help
	  Say Y here to enable
	  support for disable HV wireless charging.
	  If you are unsure, say N.
	  some models need this for not support high voltage wireless charging.

config CS100_JPNCONCEPT
	bool "cs100 command support"
	depends on BATTERY_SAMSUNG && I2C
	help
	  Say Y here to enable
	  support for CS100 command.
	  CS100 command is to stop when full-charged.
	  only JPN models need this charging concepts.

config WIRELESS_FIRMWARE_UPDATE
	bool "WIRELESS IC firmware update support"
	depends on BATTERY_SAMSUNG
	help
	  Say Y here to enable
	  support for the wireless charger IC firmware update.
	  it need firmware bin in firmware folder.
	  It is for MFC IC.

endmenu
```

## exynos/device/univ/universal9925/drivers/samsung/Kconfig
```kconfig
# drivers/samsung/debug/Kconfig
#
# Copyright (c) 2010-2020 Samsung Electronics Co., Ltd.
#               http://www.samsung.com/
#
# Licensed under GPLv2

menu "Samsung TN Extension Feature"
config SEC_EXT
	bool "Samsung TN extension Feature"
	default y

menuconfig SEC_DEBUG
	tristate "Enable Samsung Debugging features"
	default n

config SEC_REBOOT
	tristate "Enable TN reboot features"
	depends on SEC_DEBUG
	default n
	help
	  Samsung TN reboot extension Feature. Do additional work when reboot.

config SEC_KEY_NOTIFIER
	tristate "Enable Samsung key event notifier"
	depends on SEC_DEBUG
	default n
	help
	  Samsung Key input event notifier

config SEC_PARAM
	tristate "Enable Param modification"
	depends on SEC_DEBUG
	default n
	help
	  Samsung TN Param Feature.


config DRV_SAMSUNG
	tristate "Samsung sec class/sysfs Feature"
	depends on SEC_DEBUG
	default n
	help
	  Samsung sysfs name 'sec' directory create.

endmenu
source "$(KCONFIG_EXT_PREFIX)drivers/samsung/misc/Kconfig"
```

## exynos/device/univ/universal9925/drivers/usb/typec/Kconfig
```kconfig
# drivers/usb/typec/Kconfig
#
# Copyright (c) 2010-2020 Samsung Electronics Co., Ltd.
#               http://www.samsung.com/
#
# Licensed under GPLv2

source "$(KCONFIG_EXT_PREFIX)drivers/usb/typec/common/Kconfig"
source "$(KCONFIG_EXT_PREFIX)drivers/usb/typec/manager/Kconfig"
source "$(KCONFIG_EXT_PREFIX)drivers/usb/typec/maxim/Kconfig"
```

## exynos/external-modules/bsp/class/Kconfig
```kconfig
comment "Samsung sysfs Feature"
config DRV_SAMSUNG
	tristate "Samsung sec class/sysfs Feature"
	default n
	help
	  Samsung sysfs name 'sec' directory create.
```

## exynos/external-modules/bsp/reboot/6.12/Kconfig
```kconfig
# drivers/samsung/Kconfig
#
# Copyright (c) 2010-2020 Samsung Electronics Co., Ltd.
#               http://www.samsung.com/
#
# Licensed under GPLv2
config SEC_REBOOT
	tristate "Enable Samsung reboot features"
	default n
	help
	  Samsung TN reboot extension Feature. Do additional work when reboot.
```

## exynos/external-modules/bsp/reboot/6.6/Kconfig
```kconfig
# Copyright (c) 2010-2026 Samsung Electronics Co., Ltd.
#               http://www.samsung.com/
#
# Licensed under GPLv2

config SEC_REBOOT
	tristate "Enable Samsung reboot features"
	default n
	help
	  Samsung TN reboot extension Feature. Do additional work when reboot.
```

## exynos/external-modules/bsp/sec_key_notifier/6.6/Kconfig
```kconfig
config SEC_KEY_NOTIFIER
	tristate "Enable Samsung key event notifier"
	default n
	help
	  Samsung Key input event notifier

config SEC_KN_WATCH
	bool "Change keys to support watch in event notifier"
	default n
	help
		Enable this option for watch devices.
		This will change the hold, primary, and secondary key to
		support crash key and hard reset hook in watch devices.

		          |     Phone      |     Watch
		------------------------------------------
		Hold      | KEY_VOLUMEDOWN | KEY_APPSELECT
		------------------------------------------
		Primary   | KEY_POWER      | KEY_APPSELECT
		------------------------------------------
		Secondary | KEY_VOLUMEUP   | KEY_POWER
		------------------------------------------
```

## exynos/soc-series/pamir-android15/drivers/clocksources/Kconfig
```kconfig
# SPDX-License-Identifier: GPL-2.0-only
config CLKSRC_EXYNOS_MCT_V2
	tristate "Exynos multi core timer (ver 2) driver"
	depends on ARM || ARM64
	help
	  Support for Multi Core Timer controller on Exynos SoCs.
```
