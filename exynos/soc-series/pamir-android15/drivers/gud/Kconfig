## exynos/soc-series/papaya-android15/Kconfig.ext
```kconfig
# SPDX-License-Identifier: GPL-2.0

menu  "Exynos SOC require Modules"

config SOC_S5E8825
	bool "Samsung S5E8825"
	select ARCH_EXYNOS
	help
	  Support Samsung SOC S5E8825.

source "$(KCONFIG_EXT_SOC_PREFIX)drivers/clocksources/Kconfig"
source "$(KCONFIG_EXT_SOC_PREFIX)drivers/soc/samsung/exynos/Kconfig"
source "$(KCONFIG_EXT_SOC_PREFIX)drivers/soc/samsung/exynos/cpif/Kconfig"
source "$(KCONFIG_EXT_SOC_PREFIX)drivers/soc/samsung/exynos/gnssif/Kconfig"
source "$(KCONFIG_EXT_SOC_PREFIX)drivers/tty/serial/Kconfig"
source "$(KCONFIG_EXT_SOC_PREFIX)drivers/pinctrl/samsung/Kconfig"
source "$(KCONFIG_EXT_SOC_PREFIX)drivers/iommu/samsung/Kconfig"
source "$(KCONFIG_EXT_SOC_PREFIX)drivers/dma-buf/heaps/samsung/Kconfig"
source "$(KCONFIG_EXT_SOC_PREFIX)drivers/clk/samsung/Kconfig"
source "$(KCONFIG_EXT_SOC_PREFIX)drivers/devfreq/Kconfig"
source "$(KCONFIG_EXT_SOC_PREFIX)drivers/cpufreq/Kconfig"
source "$(KCONFIG_EXT_SOC_PREFIX)drivers/dma/samsung/Kconfig"
source "$(KCONFIG_EXT_SOC_PREFIX)drivers/bts/Kconfig"
source "$(KCONFIG_EXT_SOC_PREFIX)drivers/thermal/Kconfig"
source "$(KCONFIG_EXT_SOC_PREFIX)drivers/mfd/Kconfig"
source "$(KCONFIG_EXT_SOC_PREFIX)drivers/i3c/Kconfig"
source "$(KCONFIG_EXT_SOC_PREFIX)drivers/regulator/Kconfig"
source "$(KCONFIG_EXT_SOC_PREFIX)drivers/rtc/Kconfig"
source "$(KCONFIG_EXT_SOC_PREFIX)drivers/input/keyboard/Kconfig"
source "$(KCONFIG_EXT_SOC_PREFIX)drivers/iio/adc/Kconfig"
source "$(KCONFIG_EXT_SOC_PREFIX)drivers/pinctrl/Kconfig"
source "$(KCONFIG_EXT_SOC_PREFIX)drivers/pwm/Kconfig"
source "$(KCONFIG_EXT_SOC_PREFIX)drivers/power/reset/exynos/Kconfig"
source "$(KCONFIG_EXT_SOC_PREFIX)drivers/ufs/host/Kconfig"
source "$(KCONFIG_EXT_SOC_PREFIX)sound/usb/Kconfig"
source "$(KCONFIG_EXT_SOC_PREFIX)sound/soc/samsung/exynos/Kconfig"
# source "$(KCONFIG_EXT_SOC_PREFIX)sound/soc/codecs/Kconfig"
source "$(KCONFIG_EXT_SOC_PREFIX)drivers/i2c/busses/Kconfig"
source "$(KCONFIG_EXT_SOC_PREFIX)drivers/gpu/arm/Kconfig"
source "$(KCONFIG_EXT_SOC_PREFIX)drivers/watchdog/Kconfig"
source "$(KCONFIG_EXT_SOC_PREFIX)drivers/dpu/Kconfig"
source "$(KCONFIG_EXT_SOC_PREFIX)drivers/dpu/panel/Kconfig"
source "$(KCONFIG_EXT_SOC_PREFIX)drivers/phy/samsung/Kconfig"
source "$(KCONFIG_EXT_SOC_PREFIX)drivers/power/supply/samsung/Kconfig"
source "$(KCONFIG_EXT_SOC_PREFIX)drivers/leds/samsung/Kconfig"
source "$(KCONFIG_EXT_SOC_PREFIX)drivers/soc/samsung/exynos/debug/Kconfig"
source "$(KCONFIG_EXT_SOC_PREFIX)drivers/soc/samsung/exynos/cpif/Kconfig"
source "$(KCONFIG_EXT_SOC_PREFIX)drivers/soc/samsung/exynos/gnssif/Kconfig"
source "$(KCONFIG_EXT_SOC_PREFIX)drivers/mmc/host/Kconfig"
source "$(KCONFIG_EXT_SOC_PREFIX)drivers/gud/Kconfig"
source "$(KCONFIG_EXT_SOC_PREFIX)drivers/vision/Kconfig"
source "$(KCONFIG_EXT_SOC_PREFIX)drivers/scsi/Kconfig"
source "$(KCONFIG_EXT_SOC_PREFIX)drivers/spi/Kconfig"
source "$(KCONFIG_EXT_SOC_PREFIX)drivers/usb/dwc3/Kconfig"
source "$(KCONFIG_EXT_SOC_PREFIX)drivers/usb/host/Kconfig"
source "$(KCONFIG_EXT_SOC_PREFIX)sound/usb/Kconfig"
source "$(KCONFIG_EXT_SOC_PREFIX)drivers/usb/gadget/function/Kconfig"
source "$(KCONFIG_EXT_SOC_PREFIX)drivers/staging/nanohub/Kconfig"
source "$(KCONFIG_EXT_SOC_PREFIX)kernel/sched/ems/Kconfig"
source "$(KCONFIG_EXT_SOC_PREFIX)drivers/misc/samsung/Kconfig"
source "$(KCONFIG_EXT_SOC_PREFIX)drivers/net/wireless/Kconfig"
source "$(KCONFIG_EXT_SOC_PREFIX)drivers/mfc/Kconfig"
source "$(KCONFIG_EXT_SOC_PREFIX)drivers/scaler/Kconfig"
source "$(KCONFIG_EXT_SOC_PREFIX)drivers/smfc/Kconfig"
source "$(KCONFIG_EXT_SOC_PREFIX)drivers/soc/samsung/xperf/Kconfig"
source "$(KCONFIG_EXT_SOC_PREFIX)drivers/media/radio/Kconfig"
source "$(KCONFIG_EXT_SOC_PREFIX)drivers/block/zram/Kconfig"
source "$(KCONFIG_EXT_SOC_PREFIX)mm/sec_mm/Kconfig"
endmenu
```

## exynos/soc-series/papaya-android15/drivers/cpufreq/Kconfig
```kconfig
# SPDX-License-Identifier: GPL-2.0
#
# Samsung SoC drivers
#

config ARM_FREQ_QOS_TRACER
	tristate "SAMSUNG CPUFreq QoS Tracer"
	depends on ARCH_EXYNOS
	help
	  Enable CPUFreq QoS Tracer

config ARM_EXYNOS_ACME
    tristate "SAMSUNG EXYNOS CPUFreq driver"
    default n
    depends on ARCH_EXYNOS
    help
        This adds the CPUFreq driver for every exynos chipset

config ARM_EXYNOS_DSU_FREQ
	tristate "SAMSUNG EXYNOS DSU Frequency driver"
	help
	  This adds the DSUFreq driver for specific exynos chipset. Exynos
	  DSUFreq supported SoC must use the exynos CAL framework.
```

## exynos/soc-series/papaya-android15/drivers/devfreq/Kconfig
```kconfig
if PM_DEVFREQ

config ARM_EXYNOS_DEVFREQ
	tristate "ARM Exynos Memory Bus DEVFREQ Common driver"
	default m
	depends on ARCH_EXYNOS
	select PM_OPP
	help
	  This adds the DEVFREQ driver for Exynos series common bus

config ARM_EXYNOS_DEVFREQ_DEBUG
	tristate "ARM Exynos DEVFREQ sysfs for Debug"
	default m
	depends on ARM_EXYNOS_DEVFREQ

config EXYNOS_ALT_DVFS
	tristate "ALT(Active Load Tracing) DVFS"
	default n
	depends on ARM_EXYNOS_DEVFREQ
	help
	  Enable ALT-DVFS scheme for simpleinteractive governor.
	  When ALT-DVFS is enabled, governor will start to trace and
	  calculate memory load based on activated cycle. Simpleinteractive
	  governor decides new frequency for DVFS by comparing current load
	  and PM QoS requests.

config EXYNOS_ALT_DVFS_DEBUG
	tristate "ALT(Active Load Tracing) DVFS Debugging Feature"
	depends on EXYNOS_ALT_DVFS
	help
	  For ALT-DVFS Debugging

endif
```

## exynos/soc-series/papaya-android15/drivers/i2c/busses/Kconfig
```kconfig
config I2C_EXYNOS5_EXT
        tristate "Exynos high-speed I2C driver"
#        depends on OF
#        depends on ARCH_EXYNOS || COMPILE_TEST
        help
          High-speed I2C controller on Exynos5 and newer Samsung SoCs.
```

## exynos/soc-series/papaya-android15/drivers/pinctrl/samsung/Kconfig
```kconfig
# SPDX-License-Identifier: GPL-2.0
#
# Samsung Pin control external drivers
#
config PINCTRL_SAMSUNG_EXT
	tristate "External Pinctrl driver data for Samsung SoCs"
	select GPIOLIB
	select PINMUX
	select PINCONF

config PINCTRL_EXYNOS_EXT
	bool "External Pinctrl common driver part for Samsung Exynos SoCs"
	depends on ARCH_EXYNOS || PINCTRL_SAMSUNG_EXT || (COMPILE_TEST && OF)
	select PINCTRL_EXYNOS_EXT_ARM64 if ARCH_EXYNOS && ARM64

config PINCTRL_EXYNOS_EXT_ARM64
	bool "ARMv8-specific pinctrl driver for Samsung Exynos SoCs" if COMPILE_TEST
	depends on PINCTRL_EXYNOS

config PINCTRL_SEC_GPIO_DVS
	tristate "Samsung GPIO debugging and verification system"
	depends on SEC_PM && PINCTRL_EXYNOS_ARM64
	default n
```

## exynos/soc-series/papaya-android15/drivers/tty/serial/Kconfig
```kconfig
# SPDX-License-Identifier: GPL-2.0
#
# Serial device configuration
#

config SERIAL_EXYNOS
	tristate "Exynos SoC serial support"
	depends on PLAT_SAMSUNG || ARCH_EXYNOS
	select SERIAL_CORE
	help
	  Support for the on-chip UARTs on the Samsung Exynos series CPUs,
	  providing /dev/ttySAC0, 1 and 2 (note, some machines may not
	  provide all of these ports, depending on how the serial port
	  pins are configured.

config SERIAL_EXYNOS_UARTS
	int
	depends on SERIAL_EXYNOS
	default 16
	help
	  Select the number of available UART ports for the Samsung
	  Exynos serial driver

config S3C_LOWLEVEL_UART_PORT
        int "S3C UART to use for low-level messages"
        default 0
        help
          Choice of which UART port to use for the low-level messages,
          such as the `Uncompressing...` at start time. The value of
          this configuration should be between zero and two. The port
          must have been initialised by the boot-loader before use.
```
