## exynos/soc-series/pamir-android15/drivers/gud/Kconfig
```kconfig
#
# Mobicore Configuration
#
source "$(KCONFIG_EXT_SOC_PREFIX)drivers/gud/gud-s5e9925/Kconfig"
```

## exynos/soc-series/pamir-android15/drivers/i2c/busses/Kconfig
```kconfig
# SPDX-License-Identifier: GPL-2.0-only

comment "HSI2C Drivers"

config I2C_EXYNOS5_EXT
	tristate "Exynos high-speed I2C driver"
	depends on OF
	depends on ARCH_EXYNOS || COMPILE_TEST
	help
	  High-speed I2C controller on Samsung Exynos5 and newer Samsung SoCs
```

## exynos/soc-series/pamir-android15/drivers/iio/adc/Kconfig
```kconfig
# SPDX-License-Identifier: GPL-2.0-only
#
# SAMSUNG PMIC ADC drivers
#
# When adding new entries keep the list in alphabetical order

config S2MPS25_ADC
	tristate "S2MPS25 ADC driver support for 9925"
	depends on MFD_S2MPS25
	help
	  Core support for the ADC block found in the Samsung PMIC series
	  for drivers such as the touchscreen and hwmon to use to share
	  this resource.

	  To compile this driver as a module, choose M here: the module will be
	  called s2mps25_adc.
```

## exynos/soc-series/pamir-android15/drivers/input/keyboard/Kconfig
```kconfig
# SPDX-License-Identifier: GPL-2.0-only
#
# Input core configuration
#

config KEYBOARD_S2MPS25
	tristate "Samsung Electronics S2MPS25 Powerkey/Vol-down Controller"
	depends on I2C
	depends on MFD_S2MPS25
```

## exynos/soc-series/pamir-android15/drivers/mfd/Kconfig
```kconfig
# SPDX-License-Identifier: GPL-2.0-only
#
# Multifunction miscellaneous devices for samsung pmic
#

config MFD_S2MPB02
	tristate "Samsung Semiconductor S2MPB02 PMIC Support"
	depends on I2C=y
	select MFD_CORE
	help
	  Say yes here to support for Samsung Semiconductor S2MPB02.
	  This is a Power Management IC with Flash on chip.
	  This driver provides common support for accessing the device;
	  additional drivers

config MFD_S2MPS25
	tristate "SAMSUNG Electronics S2MPS25 PMIC Series Support for s5e9925"
	depends on I2C=y
	select MFD_CORE
	select REGULATOR
	help
	  Support for the Samsung Electronics MFD series.
	  This driver provides common support for accessing the device,
	  additional drivers must be enabled in order to use the functionality
	  of the device

config MFD_S2MPS26
	tristate "SAMSUNG Electronics S2MPS26 PMIC Series Support for s5e9925"
	depends on I2C=y
	select MFD_CORE
	select REGULATOR
	help
	  Support for the Samsung Electronics MFD series.
	  This driver provides common support for accessing the device,
	  additional drivers must be enabled in order to use the functionality
	  of the device

config MFD_S2MPM07
	tristate "SAMSUNG Electronics S2MPM07 PMIC Series Support for s5e9925"
	depends on I2C=y
	select MFD_CORE
	select REGULATOR
	help
	  Support for the Samsung Electronics MFD series.
	  This driver provides common support for accessing the device,
	  additional drivers must be enabled in order to use the functionality
	  of the device
```

## exynos/soc-series/pamir-android15/drivers/pci/controller/dwc/Kconfig
```kconfig
# SPDX-License-Identifier: GPL-2.0

config PCI_EXYNOS_HOST
	tristate "Samsung Exynos PCIe controller"
	depends on ARCH_EXYNOS || COMPILE_TEST
	select PCIE_DW_HOST
	help
	  Enables support for the PCIe controller in the Samsung Exynos SoCs
	  to work in host mode. The PCI controller is based on the DesignWare
	  hardware and therefore the driver re-uses the DesignWare core
	  functions to implement the driver.

config PCIE_EXYNOS_DWPHY
	tristate "Samsung Exynos PCIe RC with Synopsys PHY"
	depends on PCI_EXYNOS_HOST

config PCI_EXYNOS_S5E9925
	tristate "Samsung Exynos PCIe controller S5E9925"
	depends on PCI
	depends on OF
	select PCIE_DW_HOST

config PCI_EXYNOS_S5E9925_S5300
	tristate "Samsung Exynos PCIe controller S5E9925 and S5300"
	depends on PCI
	depends on OF
	select PCIE_DW_HOST
```

## exynos/soc-series/pamir-android15/drivers/pinctrl/Kconfig
```kconfig
# SPDX-License-Identifier: GPL-2.0-only
#
# SAMSUNG PINCTRL infrastructure and pmic drivers
#

config PINCTRL_SAMSUNG_S2MPS26
	tristate "SAMSUNG PMIC pin controller driver for s5e9925"
	help
	 This is the pinctrl, pinmux, pinconf and gpiolib driver for the
	 Samsung GPIO found in the Samsung PMIC's chips, which are using
	 SPMI for communication with SoC.

config PINCTRL_SAMSUNG_S2MPM07
	tristate "SAMSUNG PMIC pin controller driver for s5e9925"
	help
	 This is the pinctrl, pinmux, pinconf and gpiolib driver for the
	 Samsung GPIO found in the Samsung PMIC's chips, which are using
	 SPMI for communication with SoC.
```

## exynos/soc-series/pamir-android15/drivers/regulator/Kconfig
```kconfig
config DRV_SAMSUNG_PMIC
	tristate "Samsung PMIC common and sysfs system"
	help
	 This driver supports a Samsung PMIC sysfs amd common.

config REGULATOR_S2MPS25
	tristate "Samsung S2MPS25 voltage regulator for s5e9945"
	depends on MFD_S2MPS25
	help
	  This driver supports a Samsung S2MPS25 voltage output regulator
	  via SPMI bus. S2MPS25 is comprised of high efficient Buck converters
	  including Dual-Phase Buck converter, Buck-Boost converter, various LDOs.

config REGULATOR_S2MPS26
	tristate "Samsung S2MPS26 voltage regulator for s5e9945"
	depends on MFD_S2MPS26
	help
	  This driver supports a Samsung S2MPS26 voltage output regulator
	  via SPMI bus. S2MPS26 is comprised of high efficient Buck converters
	  including Dual-Phase Buck converter, Buck-Boost converter, various LDOs.

config REGULATOR_S2MPM07
	tristate "Samsung S2MPM07 voltage regulator for s5e9945"
	depends on MFD_S2MPM07
	help
	  This driver supports a Samsung S2MPM07 voltage output regulator
	  via SPMI bus. S2MPM07 is comprised of high efficient Buck converters
	  including Dual-Phase Buck converter, Buck-Boost converter, various LDOs.

config REGULATOR_S2MPB02
	tristate "Samsung S2MPB02 regulator"
	depends on MFD_S2MPB02
	help
	  This driver controls a Samsung S2MPB02 regulator
	  via I2C bus.

config REGULATOR_S2DOS05
	tristate "Samsung S2DOS05 regulator"
	depends on I2C
	help
	  This driver controls a Samsung S2DOS05 regulator
	  via I2C bus.
```

## exynos/soc-series/pamir-android15/drivers/rtc/Kconfig
```kconfig
# SPDX-License-Identifier: GPL-2.0-only
#
# PMIC RTC class/drivers configuration
#

config RTC_S2MPS25
	tristate "Samsung PMIC RTC for 9925"
	depends on MFD_S2MPS25
	help
	  If you say yes here you will get support for the
	  RTC of Samsung PMIC series.
	  This driver can also be built as a module. If so, the module
	  will be called rtc-s2mps25.
```

## exynos/soc-series/pamir-android15/drivers/soc/samsung/Kconfig
```kconfig
# SPDX-License-Identifier: GPL-2.0-only
#
# Samsung SoC drivers
#

config EXYNOS_CPUHP
	tristate "CPU Hotplug driver support"
	default n
	help
	  Support CPU Hotplug interface for Exynos SoC.

config EXYNOS_CPUPM
	tristate "Exynos CPU Power Management driver"
	depends on ARCH_EXYNOS && PMUCAL
	default n
	help
	  Support Exynos CPU Power Control for EXYNOS SoC.

config EXYNOS_AFM
	tristate "Exynos AFM Handler"
	depends on CPU_FREQ
	default n
	help
	  Enable AFM handler for Exynos SoC.

config EXYNOS_UFCC
	tristate "User Frequency & C-state Control"
	depends on EXYNOS_CPUPM && ARM_EXYNOS_ACME
	default n
	help
	  Control Frequency & C-state by user
```

## exynos/soc-series/pamir-android15/drivers/spi/Kconfig
```kconfig
# SPDX-License-Identifier: GPL-2.0-only
#
# External SPI driver configuration
#
comment "SPI Drivers"

config SPI_S3C64XX_EXT
	tristate "Samsung S3C64XX/Exynos SoC series type SPI"
	depends on (PLAT_SAMSUNG || ARCH_EXYNOS || COMPILE_TEST)
	help
	  SPI driver for Samsung S3C64XX, Exynos SoCs.
	  Choose Y/M here only if you build for such Samsung SoC.
```

## exynos/soc-series/pamir-android15/drivers/ufs/host/Kconfig
```kconfig
# SPDX-License-Identifier: GPL-2.0+
#
# Kernel configuration file for the UFS host controller drivers.
#
# Copyright (C) 2023 Samsung Electronics Co., Ltd.
#
# Authors:
#	Kiwoong Kim <kwmad.kim@samsung.com>

config SCSI_UFS_SAMSUNG
	tristate "Exynos specific hooks to UFS controller platform driver"
	depends on SCSI_UFSHCD_PLATFORM && (ARCH_EXYNOS || COMPILE_TEST)
	help
	  This selects the Samsung Exynos SoC specific additions to UFSHCD
	  platform driver.  UFS host on Samsung Exynos SoC includes HCI and
	  UNIPRO layer, and associates with UFS-PHY driver.

	  Select this if you have UFS host controller on Samsung Exynos SoC.
	  If unsure, say N.

config SCSI_UFS_PERF
	tristate "Exynos specific perf hook to UFS controller platform driver"
	depends on SCSI_UFS_SAMSUNG
	help
	  This selects the Samsung Exynos SoC specific performance feature
	  to UFSHCD platform driver.

	  Select this if you have UFS host controller on Samsung Exynos SoC,
	  and want to enable this feature.
	  If unsure, say N.

config SCSI_UFS_DBG
	tristate "Exynos specific dbg hooks to UFS controller platform driver"
	depends on SCSI_UFS_SAMSUNG
	help
	  This selects the Samsung Exynos SoC specific debuggin additions to
	  to UFSHCD platform driver.

	  Select this if you have UFS host controller on Samsung Exynos SoC,
	  and want to enable this feature.
	  If unsure, say N.

config SCSI_UFS_EMUL
	tristate "Exynos specific emul mode to UFS controller platform driver"
	depends on SCSI_UFS_SAMSUNG
	help
	  This selects the Samsung Exynos SoC specific emulation mode
	  to UFSHCD platform driver.

	  Select this if you have UFS host controller on Samsung Exynos SoC,
	  and want to enable this feature.
	  If unsure, say N.

config SCSI_UFS_EXYNOS_SRPMB
	bool "EXYNOS Secure RPMB(Replay Protected Memory Block) UFS Host"
	depends on SCSI_UFS_SAMSUNG
	help
	  RPMB(Replay Protected Memory Block) is a storage which is to store data
	  to the specific memory area in an authenticated and replay protected manner.
	  Usage of nonce and write count register are providing additional
	  protection against replay of messages where messages could be recorded and
	  played back later by an attacker.

	  If you have a controller with this interface, say Y or M here. If unsure, say N.

config SCSI_UFS_EXYNOS_FMP
        bool "EXYNOS Flash Memory Protector for UFS Host"
        depends on SCSI_UFS_SAMSUNG && SCSI_UFS_CRYPTO
        help
          This selects the EXYNOS UFS FMP Driver.

          Select this if you need a inline crypto engine for your UFS controller.
          If unsure, say N.

choice
        prompt "Option for FMP mode"
        depends on SCSI_UFS_EXYNOS_FMP
        default HW_KEYS_IN_CUSTOM_KEYSLOT

config HW_KEYS_IN_CUSTOM_KEYSLOT
        bool "Init fmp to use hw wrapped keys in custom keyslot"
        depends on SCSI_UFS_EXYNOS_FMP
        help
          Choose here to select that fmp mode to use hw wrapped keys in custom keyslot.

config KEYS_IN_CUSTOM_KEYSLOT
        bool "Init fmp to use keys in custom keyslot"
        depends on SCSI_UFS_EXYNOS_FMP
        help
          Choose here to select that fmp mode to use keys in custom keyslot.

config KEYS_IN_PRDT
        bool "Init fmp to use keys in prdt"
        depends on SCSI_UFS_EXYNOS_FMP
        help
          Choose here to select that fmp mode to use keys in prdt

endchoice
```

## exynos/soc-series/pamir-android15/drivers/watchdog/Kconfig
```kconfig
# SPDX-License-Identifier: GPL-2.0-only

#
# Watchdog device configuration
#

config S3C2410_WATCHDOG_EXT
	tristate "S3C2410 Watchdog"
	depends on ARCH_S3C24XX || ARCH_S3C64XX || ARCH_S5PV210 || ARCH_EXYNOS || \
		   COMPILE_TEST
	select WATCHDOG_CORE
	select MFD_SYSCON if ARCH_EXYNOS
	help
	  Watchdog timer block in the Samsung SoCs. This will reboot
	  the system when the timer expires with the watchdog enabled.

	  The driver is limited by the speed of the system's PCLK
	  signal, so with reasonably fast systems (PCLK around 50-66MHz)
	  then watchdog intervals of over approximately 20seconds are
	  unavailable.

	  The driver can be built as a module by choosing M, and will
	  be called s3c2410_wdt

config S3C2410_EXT_SHUTDOWN_REBOOT
	bool "Support watchdog reset after watchdog shutdown"
	depends on S3C2410_WATCHDOG_EXT
	default n
	help
	  This config disable the shutdown function of S3C2410 watchdog.
	  To prevent stuck after watchdog driver shutdown, shutdown
	  function will not stop or disable watchdog and it will just
	  kick 30 second. It will prevent being stucked in reset
	  sequence with some other failure.
	  This feature is not recommeneded for debugging.

config S3C2410_EXT_BUILTIN_WATCHDOG
	bool "Support S3C2410 Built-in Watchdog API"
	depends on S3C2410_WATCHDOG
	default n
	help
	  Supports direct WDT reset API for builtin call only.
	  S3C2410_WATCHDOG driver support normal watchdog feature including
	  direct watchdog reset API. But when it works as kernel module,
	  builtin APIs cannot use it.
	  So, support direct WDT reset API only for SOC debug purpose.
```
