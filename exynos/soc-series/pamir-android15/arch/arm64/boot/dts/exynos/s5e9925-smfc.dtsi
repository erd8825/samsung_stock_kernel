/* SPDX-License-Identifier: GPL-2.0-only */
/*
 * EXYNOS SMFC device tree source for SMFC IP
 *
 * Copyright (c) 2012 Samsung Electronics Co., Ltd.
 *		http://www.samsung.com
 */
#include <dt-bindings/clock/s5e9925.h>
#include <dt-bindings/interrupt-controller/s5e9925.h>
#include <dt-bindings/soc/samsung/exynos_pm_qos.h>

/ {
	aliases {
		smfc0 = &smfc_0;
		smfc1 = &smfc_1;
	};

	smfc_0: smfc@18940000 {
		compatible = "samsung,exynos8890-jpeg";
		dma-coherent;
		reg = <0x0 0x18940000 0x1000>;
		interrupts = <0 INTREQ__M2M__JPEG0 IRQ_TYPE_LEVEL_HIGH 0>;
		iommus = <&sysmmu_d_m2m>;
		samsung,iommu-group=<&iommu_group_mscl_smfc>;
		core_dvfs_class = <PM_QOS_DEVICE_THROUGHPUT>;
		smfc,int_qos_minlock = <800000>;
		smfc,mif_qos_minlock = <1014000>;
		smfc_bpc = <16>;
		smfc_core_clk = <800000>;
	};

	smfc_1: smfc@18950000 {
		compatible = "samsung,exynos8890-jpeg";
		dma-coherent;
		reg = <0x0 0x18950000 0x1000>;
		interrupts = <0 INTREQ__M2M__JPEG1 IRQ_TYPE_LEVEL_HIGH 0>;
		iommus = <&sysmmu_d_m2m>;
		samsung,iommu-group=<&iommu_group_mscl_smfc>;
		core_dvfs_class = <PM_QOS_DEVICE_THROUGHPUT>;
		smfc,int_qos_minlock = <800000>;
		smfc,mif_qos_minlock = <1014000>;
		smfc_bpc = <16>;
		smfc_core_clk = <800000>;
	};
};
